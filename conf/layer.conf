## conf/layer.conf
```bitbake
# We have a conf and classes directory, add to BBPATH
BBPATH .= ":${LAYERDIR}"

# We have recipes-* directories, add to BBFILES
BBFILES += "${LAYERDIR}/recipes-*/*/*.bb \
            ${LAYERDIR}/recipes-*/*/*.bbappend"

BBFILE_COLLECTIONS += "meta-ruby"
BBFILE_PATTERN_meta-ruby = "^${LAYERDIR}/"
BBFILE_PRIORITY_meta-ruby = "6"

LAYERDEPENDS_meta-ruby = "core"
LAYERSERIES_COMPAT_meta-ruby = "kirkstone"
```
